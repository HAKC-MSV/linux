## arch/arm64/Kconfig.hakc
```kconfig
config HAKC_ARM_V8
  bool "Enable HAKC for ARM V8"
  depends on CRYPTO_SHA256_ARM64 && HAKC
  default n
  help
    Allow for compartmentalization protections using SHA hashing.

config HAKC_ARM_V8_MEMORY
  bool "Use memory for HAKC ARM V8 tagging implementation"
  depends on HAKC_ARM_V8
  default y
  help
    Use allocated memory for software tag store.

config HAKC_ARM_V8_BTREE
  bool "Use binary tree for HAKC ARM V8 tagging implementation"
  depends on HAKC_ARM_V8 && !HAKC_ARM_V8_MEMORY
  default n
  help
    Use binary tree for software tag store.

config HAKC_ARM_V9
  bool "Enable HAKC for ARM V9"
  depends on ARM64_MTE && HAKC
  default n
  help
    Allow for compartmentalization protections using MTE and PAC.
```

## arch/x86/Kconfig.hakc
```kconfig
config HAKC_X86
  bool "Enable HAKC for X86-64"
  depends on HAKC && X86
  default n
  help
    Allow for compartmentalization protections using SHA hashing.

config HAKC_X86_SIGN_NI
  bool "Use NI SHA-256 implementation for pointer signing"
  depends on HAKC_X86 && AS_SHA256_NI
  default n
  help
    Use NI implementation of SHA-256 for pointer signing and authentication when available..

config HAKC_X86_SIGN_SSSE3
  bool "Use SSSE3 SHA-256 implementation for pointer signing"
  depends on HAKC_X86 && !HAKC_X86_SIGN_NI && CRYPTO_SHA256_SSSE3
  default y
  help
    Use SSSE3 implementation of SHA-256 for pointer signing and authentication when NI is not available.

config HAKC_X86_MEMORY
  bool "Use memory for HAKC X86-64 tagging implementation"
  depends on HAKC_X86 && (HAKC_X86_SIGN_SSSE3 || HAKC_X86_SIGN_NI)
  default y
  help
    Use allocated memory for software tag store.

config HAKC_X86_BTREE
  bool "Use binary tree for HAKC X86-64 tagging implementation"
  depends on HAKC_X86 && (HAKC_X86_SIGN_SSSE3 || HAKC_X86_SIGN_NI) && !HAKC_X86_MEMORY
  default n
  help
    Use binary tree for software tag store.
```

## drivers/rosdemo/Kconfig
```kconfig
# SPDX-License-Identifier: GPL-2.0-only
#
# ROSDEMO configuration.
#

config ROSDEMO
	tristate "ROS Demo malicious driver"
	depends on PCI
	help
	  Set this to M for the purposefully buggy ROS kernel module.
	  DO NOT INCLUDE IN ANY PATCH!
```

## kernel/Kconfig.hakc
```kconfig
menu "HAKC"
  depends on 64BIT && (AS_SHA256_NI || CRYPTO_SHA256_SSSE3 || CRYPTO_SHA256_ARM64 || ARM64_MTE)

config HAKC
  bool "Enable HAKC"
  default n
  depends on DEBUG_INFO_DWARF5 || DEBUG_INFO_DWARF4 || DEBUG_INFO_DWARF_TOOLCHAIN_DEFAULT

config HAKC_CONFIG_PATH
  depends on HAKC
  string "HAKC Configuration File Path"
  default ""
  help
    The path to the HAKC configuration path.

source "arch/x86/Kconfig.hakc"
source "arch/arm64/Kconfig.hakc"

config HAKC_DEBUG_PRINT
  bool "Print HAKC debug information"
  depends on HAKC
  default n

config HAKC_ALLOW_FAILED
  bool "Allow pointers that fail authentication"
  depends on HAKC
  default y
  help
    If a pointer fails the HAKC check, return a valid
    pointer anyway. This effectively disables the HAKC
    protections, but the check happens anyway.

config HAKC_LOG_FAILURE
  bool "Track failed HAKC accesses"
  depends on HAKC && PROC_FS
  default n
  help
    Track the number of accesses and failed HAKC pointer accesses.

config HAKC_DEMO_LEAK
  bool "Enable leaking pointers for HAKC demos"
  default n
  depends on HAKC
  help
    Allows pointers to be leaked for HAKC demos

config HAKC_XPAD_INSERT_COMMAND
  bool "Insert extra commands into Kobuki streams for HAKC Turtlebot 2 demo"
  default n
  depends on HAKC
  help
    When enabled, inserts LED toggle command into Kobuki command stream going to Turtlebot.

config HAKC_XPAD_RANDOMIZE
  bool "Periodically flip the sign of radius and speed values in Kobuki BaseCommands."
  default n
  depends on HAKC
  help
    When enabled, the speed and radius values in Kobuki BaseCommands will be modified every N seconds under exploit.

config HAKC_XPAD_RANDOMIZE_INTERVAL
  int "Interval for modifying Kobuki BaseCommands."
  depends on HAKC_XPAD_RANDOMIZE
  default 5
  help
    Interval length for modifying Kobuki BaseCommands..

config HAKC_KOBUKI_CHECKSUM_TWEAK
  bool "Keep doing checksum for non-BaseCommand payloads."
  default n
  depends on HAKC
  help
    Did not have checksum update for non-BaseCommand payloads before and it still worked, just in case.

endmenu
```
